#include "includes.h"


/*
**********************************************************************************************************
											函数声明
**********************************************************************************************************
*/
void ControlTaskCreate(void);

__task void TaskCTRLMotor(void);	//电机控制
__task void TaskCTRLSerov(void);	//舵机控制



/*
**********************************************************************************************************
											 变量
**********************************************************************************************************
*/
static uint64_t TaskCTRLMotorStk[1024/8];  /* 任务栈 */
static uint64_t TaskCTRLSerovStk[1024/8];  /* 任务栈 */

/* 任务句柄 */
OS_TID HandleTaskCTRLMotor = NULL;
OS_TID HandleTaskCTRLSerov = NULL;

/*
*********************************************************************************************************
*	函 数 名: TaskCTRLMotor
*	功能说明: 底盘电机控制
*	形    参: 无
*	返 回 值: 无
*   优 先 级: 7  
*********************************************************************************************************
*/
__task void TaskCTRLMotor(void)
{
	TIM2->CNT = 0;
	TIM3->CNT = 0;
	TIM4->CNT = 0;
	
	/*   PID   */
	PID_set(&PID_1,5,0,0,0,8999);
	PID_set(&PID_2,5,0,0,0,8999);
	PID_set(&PID_3,5,0,0,0,8999);
	PID_set(&PID_gy955,5,0,0,0,30);
	
	/* 使用周期性延时，保证采集时间准确 */
	os_itv_set(10);
    while(1)
    {	
		os_itv_wait();		
		Update_Speed(); // 编码盘测速
		
		DianJi_Speed(); // 电机
					
    }
}
/*
*********************************************************************************************************
*	函 数 名: TaskCTRLSerov
*	功能说明: 云台舵机控制
*	形    参: 无
*	返 回 值: 无
*   优 先 级: 6 
*********************************************************************************************************
*/
	double ADC_DianCi = 0;

__task void TaskCTRLSerov(void)
{
	
    while(1)
    {
		/***************测试代码*******************************/
				#if 0	
				LED_BLUE_ON();
				LED_WHITE_ON();
				QIANG_ON();
				BEEP_OFF();
				#endif
		/**********************************************/
		
		ADC_DianCi = get_temprate();

		if(ADC_DianCi <= 2.59)
		{
			BEEP_ON();
			os_dly_wait(1000);
			BEEP_OFF();
			os_dly_wait(1000);			
		}
		os_dly_wait(1000);
    }
}
/*
*********************************************************************************************************
*	函 数 名: ControlTaskCreate
*	功能说明: 创建控制任务
*	形    参: 无
*	返 回 值: 无
*********************************************************************************************************
*/
void ControlTaskCreate(void)
{
	
	HandleTaskCTRLMotor = os_tsk_create_user(TaskCTRLMotor,              /* 任务函数 */ 
	                                      7,                        	 /* 任务优先级 */ 
	                                      &TaskCTRLMotorStk,        	 /* 任务栈 */
	                                      sizeof(TaskCTRLMotorStk)); 	 /* 任务栈大小，单位字节数 */
	HandleTaskCTRLSerov = os_tsk_create_user(TaskCTRLSerov,              /* 任务函数 */ 
										  6,                        	 /* 任务优先级 */ 
										  &TaskCTRLSerovStk,        	 /* 任务栈 */
										  sizeof(TaskCTRLSerovStk)); 	 /* 任务栈大小，单位字节数 */
	
}


